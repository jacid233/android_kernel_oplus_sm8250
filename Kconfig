## Kconfig
```kconfig
# SPDX-License-Identifier: GPL-2.0
#
# For a description of the syntax of this configuration file,
# see Documentation/kbuild/kconfig-language.txt.
#
mainmenu "Linux/$(ARCH) $(KERNELVERSION) Kernel Configuration"

comment "Compiler: $(CC_VERSION_TEXT)"

#ifdef VENDOR_EDIT
#Wen.Luo@Bsp.Kernel.Stability, 2018/12/05, Add for aging test, slub debug config
config OPPO_SLUB_TEST
	string
	default "$(OPPO_SLUB_TEST)"

config OPPO_KASAN_TEST
	string
	default "$(OPPO_KASAN_TEST)"

config OPPO_KMEMLEAK_TEST
	string
	default "$(OPPO_KMEMLEAK_TEST)"

config OPPO_AGING_TEST
	string
	default "$(OPPO_AGING_TEST)"

config OPPO_PAGEOWNER_TEST
	string
	default "$(OPPO_PAGEOWNER_TEST)"
#endif

source "scripts/Kconfig.include"

source "init/Kconfig"

source "kernel/Kconfig.freezer"

source "fs/Kconfig.binfmt"

source "mm/Kconfig"

source "net/Kconfig"

source "drivers/Kconfig"

source "fs/Kconfig"

source "security/Kconfig"

source "crypto/Kconfig"

source "lib/Kconfig"

source "lib/Kconfig.debug"
```

## block/oppo_uxio_first/Kconfig
```kconfig
# SPDX-License-Identifier: GPL-2.0
#
# Block layer core configuration
#

config OPLUS_FEATURE_UXIO_FIRST
	bool "Support for oppo ux io first opt"
	default y
	help
	  Enable oppo ux io first opt.
```

## drivers/power/Kconfig
```kconfig
source "drivers/power/avs/Kconfig"
source "drivers/power/reset/Kconfig"
source "drivers/power/supply/Kconfig"

#ifdef VENDOR_EDIT /* Jianchao.Shi@BSP.CHG.Basic, 2018/01/12, sjc Add for charging */
config OPLUS_SM8250_CHARGER
	tristate "OPLUS SM8150 charger driver"
	depends on MFD_SPMI_PMIC
	help
	  Enables support for the oplus charging framework

config OPLUS_SM7250R_CHARGER
	tristate "OPLUS SM7250R charger driver"
	depends on MFD_SPMI_PMIC
	help
	  Enables support for the oplus charging framework

config OPPO_SHORT_C_BATT_CHECK
	tristate "OPPO_SHORT_C_BATT CHECK SUPPORT"
	default n
	depends on MFD_SPMI_PMIC
	help
	  Say Y to include support

config OPPO_CALL_MODE_SUPPORT
	bool "OPPO call mode support"
	help
	  Say Y to include support

config OPPO_SMART_CHARGER_SUPPORT
	bool "OPPO smart charger support"
	help
	  Say Y to include support

config OPPO_SHORT_HW_CHECK
	tristate "OPPO_SHORT_HW CHECK SUPPORT"
	default n
	depends on MFD_SPMI_PMIC
	help
	  Say Y to include support

config OPPO_CHIP_SOC_NODE
	bool "OPPO chip soc node"
	help
	  Say Y to include support


config OPPO_SHORT_IC_CHECK
	tristate "OPPO_SHORT_IC CHECK SUPPORT"
	default n
	depends on MFD_SPMI_PMIC
	help
	  Say Y to include support

config OPPO_SHORT_USERSPACE
	bool "OPPO batt userspace"
	help
	 Say Y to include support

config OPPO_RTC_DET_SUPPORT
	tristate "OPPO RTC DET SUPPORT"
	default n
	depends on MFD_SPMI_PMIC
	help
	  Say Y to include support

config OPPO_CHECK_CHARGERID_VOLT
	tristate "OPPO CHECK CHARGERID VOLT"
	default n
	depends on MFD_SPMI_PMIC
	help
	  Say Y to include support

config OPPO_SHIP_MODE_SUPPORT
	tristate "OPPO_SHIP_MODE_SUPPORT"
	default n
	depends on MFD_SPMI_PMIC
	help
	  Say Y to include support
source "drivers/power/oplus/Kconfig"
#endif
```

## drivers/soc/Kconfig
```kconfig
menu "SOC (System On Chip) specific Drivers"

source "drivers/soc/actions/Kconfig"
source "drivers/soc/amlogic/Kconfig"
source "drivers/soc/atmel/Kconfig"
source "drivers/soc/bcm/Kconfig"
source "drivers/soc/fsl/Kconfig"
source "drivers/soc/imx/Kconfig"
source "drivers/soc/mediatek/Kconfig"
source "drivers/soc/qcom/Kconfig"
source "drivers/soc/renesas/Kconfig"
source "drivers/soc/rockchip/Kconfig"
source "drivers/soc/samsung/Kconfig"
source "drivers/soc/sunxi/Kconfig"
source "drivers/soc/tegra/Kconfig"
source "drivers/soc/ti/Kconfig"
source "drivers/soc/ux500/Kconfig"
source "drivers/soc/versatile/Kconfig"
source "drivers/soc/xilinx/Kconfig"
source "drivers/soc/zte/Kconfig"
source "drivers/soc/oplus/Kconfig"
#ifdef VENDOR_EDIT
#/* Hank.liu@TECH.PLAT.Storage, 2020-02-18, add oppo iomonitor driver*/
source "drivers/soc/oplus/oppo_iomonitor/Kconfig"
#endif /* VENDOR_EDIT */
#ifdef VENDOR_EDIT
#wen.luo@BSP.Kernel.Stability 2020/03/25 add for oplus kernel system
source "drivers/soc/oplus/system/Kconfig"
#endif /* VENDOR_EDIT */
#ifdef VENDOR_EDIT
#Jiheng.Xie@BSP.Kernel.Performance 2020/06/18 add for oppo healthinfo
source "drivers/soc/oplus/oppo_healthinfo/Kconfig"
#endif

#ifdef OPLUS_FEATURE_POWERINFO_STANDBY
#SunFaliang@BSP.Power.Basic, 2020/07/09, add for owakelock.
source "drivers/soc/oplus/owakelock/Kconfig"
#endif /* OPLUS_FEATURE_POWERINFO_STANDBY */

#ifdef CONFIG_OPLUS_FEATURE_SENSOR_CRASH_MONITOR
#yajie.chen@BSP.Sensor, 2020/04/20, add for sensor crash monitor
source "drivers/soc/oplus/oppo_slpirst/Kconfig"
#endif

#ifdef OPLUS_FEATURE_SENSOR_SMEM
#qiuzuolin@BSP.Sensor.Basic 2020/07/31 add for oplus sensor smem
source "drivers/soc/oplus/sensor/Kconfig"
#endif /* OPLUS_FEATURE_SENSOR_SMEM */
endmenu
```

## drivers/soc/oplus/Kconfig
```kconfig
#ifdef OPLUS_FEATURE_TP_BASIC
#Renbing.Yao@BSP.TP.Init, 2020/06/18, Add for move device info
config OPPO_COMMON_SOFT
  bool "config oppo common software"
  select OPPO_ARCH_FILE
  help
        define this config to get project verion from sharemem.
        Maybe this value is from CDT or dynamic identify by hardware
        id.

config OPPO_DEVICE_IFNO
  bool "config oppo devinfo"
  select OPPO_ARCH_FILE
  help
        define this config to compile devinfo.c for device register

source "drivers/soc/oplus/device_info/Kconfig"
#endif /* OPLUS_FEATURE_TP_BASIC */

#ifdef OPLUS_FEATURE_GPIO_NC
config OPLUS_GPIO_NC
  bool "config oplus gpio nc"
  help
        define this config to compile oplus_gpio.c for device register
#endif

#ifdef OPLUS_FEATURE_LOWMEM_DBG
#Hailong.Liu@BSP.Kernel.MM, 2020/06/19, Add for dump memory usage when lowmmem occurs.
source "drivers/soc/oplus/lowmem_dbg/Kconfig"
##endif /* OPLUS_FEATURE_LOWMEM_DBG */

#ifdef OPLUS_FEATURE_MEMLEAK_DETECT
#Hailong.Liu@BSP.MM 2019/03/18, Add for svelte
source "drivers/soc/oplus/oppo_svelte/Kconfig"
#endif /* OPLUS_FEATURE_MEMLEAK_DETECT */

#ifdef OPLUS_FEATURE_THERMAL_HORAE
#shuze.ma@BSP.Power.Thermal 2020/08/17, Add for thermal
source "drivers/soc/oplus/thermal/Kconfig"
#endif /* OPLUS_FEATURE_THERMAL_HORAE */
```

## drivers/soc/oplus/lowmem_dbg/Kconfig
```kconfig
config OPLUS_FEATURE_LOWMEM_DBG
        bool "OPPO Low Memory debug"
        default n
        help
          print memory usage when low mem occurs.
```

## drivers/soc/oplus/oppo_iomonitor/Kconfig
```kconfig
#ifdef VENDOR_EDIT
#/* Hank.liu@TECH.PLAT.Storage, 2020-02-18, add oppo iomonitor driver*/
config OPPO_IOMONITOR
	bool "Oppo iomonitor module"
	help
	define this config to init oppo iomonitor.

config IOMONITOR_WITH_F2FS
	bool "Filesystem is f2fs"
	depends on OPPO_IOMONITOR
	help
		define this config to support both f2fs and ext4
#endif /* VENDOR_EDIT */
```

## drivers/soc/oplus/oppo_slpirst/Kconfig
```kconfig
# ifdef OPLUS_FEATURE_SENSOR_CRASH_MONITOR
# yajie.chen add for config oppo software common soft
config OPLUS_FEATURE_SENSOR_CRASH_MONITOR
bool "config record slpirst"
help
    define this config to count the slpi restart times.
#endif
```

## drivers/soc/oplus/owakelock/Kconfig
```kconfig
#ifdef OPLUS_FEATURE_POWERINFO_STANDBY
#SunFaliang@BSP.Power.Basic, 2020/05/01, add for wakelock profiler
config OPPO_WAKELOCK_PROFILER
bool "config oppo wakelock profiler"
help
    Select this config to enable oppo wakelock profiler
#endif /* OPLUS_FEATURE_POWERINFO_STANDBY */

#ifdef OPLUS_FEATURE_POWERINFO_STANDBY
#NanweiDeng@BSP.Power.Basic, 2020/08/08, add for wakelock profiler
config OPPO_POWER_QCOM
bool "QCOM Config"
help
    Select this config to enable oppo wakelock profiler
#endif /* OPLUS_FEATURE_POWERINFO_STANDBY */

#ifdef OPLUS_FEATURE_POWERINFO_STANDBY
#WuWeiZhong@BSP.Power.Basic, 2020/06/12, add for wakelock profiler
config OPPO_POWER_MTK
bool "MTK Config"
help
    Select this config to enable oppo wakelock profiler
#endif /* OPLUS_FEATURE_POWERINFO_STANDBY */
```

## drivers/soc/oplus/sensor/Kconfig
```kconfig
config OPLUS_FEATURE_SENSOR_CFG
	tristate "oplus sensor share memory config"
	default y
	help
	  To compile this driver as a module, set M in kernel build config
	  module will be called oplus_sensor.
```

## drivers/soc/oplus/system/dump_device_info/Kconfig
```kconfig
config OPLUS_FEATURE_DUMP_DEVICE_INFO
  bool "config oppo dump device info"
  default n
  help
	define this config to  dump device info.
```

## drivers/soc/oplus/system/feedback/Kconfig
```kconfig
config OPLUS_FEATURE_FEEDBACK
  bool "Oplus system feedback"
  default n
  depends on OPLUS_SYSTEM_KERNEL
  help
    define this config to init oplus system feedback.
```

## drivers/soc/oplus/system/mdmrst/Kconfig
```kconfig
config OPLUS_FEATURE_RECORD_MDMRST
bool "config record mdmrst"
help
    define this config to count the modem restart times.
```

## drivers/soc/oplus/system/oppo_pmic_monitor/Kconfig
```kconfig
#change 'y' to 'n', if you want fo close pmic monitor
config OPLUS_FEATURE_PMIC_MONITOR
    bool "oppo pmic monitor"
    default n
    help
      define this config to init oppo pmic monitor.
```

## drivers/soc/oplus/system/oppo_saupwk/Kconfig
```kconfig
#Bin.Wen@TECH.BSP.Stability.SAUPWK 2020/06/15, Add for SAUPWK
#change 'y' to 'n', if you want fo close saupwk feature
config OPLUS_FEATURE_SAUPWK
    bool "oppo saupwk project"
    default n
    help
      define this config to init oppo saupwk.
```

## drivers/soc/oplus/system/qcom_minidump/Kconfig
```kconfig
config OPLUS_FEATURE_QCOM_MINIDUMP_ENHANCE
	 bool "qcom minidump enhance"
	default n
	depends on OPLUS_SYSTEM_KERNEL
	help
            define this config to enable qcom minidump enhance.
```

## drivers/soc/oplus/system/qcom_pmicwd/Kconfig
```kconfig
config OPLUS_FEATURE_QCOM_PMICWD
	 bool "qcom pmic watchdog"
	default n
	depends on OPLUS_SYSTEM_KERNEL
	help
            define this config to enable qcom pmic watchdog.
			export pwk dump interface to android for control pwkdump.
```

## drivers/soc/oplus/system/shutdown_detect/Kconfig
```kconfig
config OPLUS_FEATURE_SHUTDOWN_DETECT
	 bool "shutdown hang detect"
	default n
	depends on OPLUS_SYSTEM_KERNEL
	help
            define this config to enable shutdown_detect.
```

## drivers/soc/oplus/system/theia/Kconfig
```kconfig
#Gang.Yang@TECH.BSP.Stability.THEIA_PROJECT 2019/06/15, Add for THEIA_PROJECT
#change 'y' to 'n', if you want fo close theia feature
config OPLUS_FEATURE_THEIA
    bool "oppo theia project"
    default n
    help
      define this config to init oppo theia project.
```

## drivers/soc/oplus/system/uboot_log/Kconfig
```kconfig
config OPLUS_FEATURE_UBOOT_LOG
  bool "oppo system uboot log"
  default n
  depends on OPLUS_SYSTEM_KERNEL
  help
    define this config to enable QCOM platform uboot log .
```

## drivers/soc/oplus/thermal/Kconfig
```kconfig
#
# Generic thermal sysfs drivers configuration
#

config HORAE_THERMAL_SHELL
	  bool "Horae shell temp driver"
	  default y
	  help
	    Provide three thermal zones(front, frame and back) to get real shell temp.
```

## drivers/soc/oppo/Kconfig
```kconfig
config OPPO_ARCH_FILE
  bool "for build directory oppo"
  ---help---
  say Y to buid in

config OPPO_COMMON_SOFT
  bool "config oppo common software"
  select OPPO_ARCH_FILE
  help
	define this config to get project verion from sharemem.
	Maybe this value is from CDT or dynamic identify by hardware
	id.

config OPPO_DEVICE_IFNO
  bool "config oppo devinfo"
  select OPPO_ARCH_FILE
  help
	define this config to compile devinfo.c for device register
		.
source "drivers/soc/oppo/project_info/Kconfig"
source "drivers/soc/oppo/device_info/Kconfig"
source "drivers/soc/oppo/mdmrst/Kconfig"

#ifdef VENDOR_EDIT
#GaoTing.Gan@PSW.MultiMedia.MediaServer, 2019/03/07, Add for kevent feedback
source "drivers/soc/oppo/oppo_kevent_feedback/Kconfig"
#endif /* VENDOR_EDIT */

source "drivers/soc/oppo/oppo_hypnus/Kconfig"
source "drivers/soc/oppo/oppo_hypnus/Kconfig"
source "drivers/soc/oppo/oppo_kevent_feedback/Kconfig"
source "drivers/soc/oppo/oppo_healthinfo/Kconfig"

#Yajie.Chen@BSP 2019/10/18, Add for slpi monitor
source "drivers/soc/oppo/oppo_slpirst/Kconfig"

#//Wen.Luo@BSP
#Liang.Zhang@TECH.Storage.Stability.OPPO_SHUTDOWN_DETECT, 2019/04/28, Add for shutdown detect
source "drivers/soc/oppo/oppo_shutdown_detect/Kconfig"
#Kun.Hu@TECH.BSP.Stability.PHOENIX_PROJECT 2019/06/15, Add for PHOENIX_PROJECT
source "drivers/soc/oppo/oppo_phoenix/Kconfig"
#endif /* VENDOR_EDIT */

#ifdef VENDOR_EDIT
#linzhangru@PSW.TECH, 2019/11/30, Add for sau power key detection
source "drivers/soc/oppo/oppo_saupwk/Kconfig"
#endif /* VENDOR_EDIT */
```

## drivers/soc/oppo/mdmrst/Kconfig
```kconfig
config RECORD_MDMRST
bool "config record mdmrst"
help
    define this config to count the modem restart times.
```

## drivers/soc/oppo/oppo_saupwk/Kconfig
```kconfig
config OPPO_SAUPWK
       bool "config oppo saupwk feature"
       default y
       help
       This selects saupwk driver
```

## drivers/soc/oppo/oppo_slpirst/Kconfig
```kconfig
# ifdef VENDOR_EDIT
# yajie.chen add for config oppo software common soft
config RECORD_SLPIRST
bool "config record slpirst"
help
    define this config to count the slpi restart times.
#endif /* VENDOR_EDIT */
```
