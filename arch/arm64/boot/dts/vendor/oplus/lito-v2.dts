/dts-v1/;

#include "../qcom/lito-v2.dtsi"
#include "lito-oem-common.dtsi"

/ {
        model = "Qualcomm Technologies, Inc. Lito v2 SoC";
        compatible = "qcom,lito";
        qcom,board-id = <0 0 0>;
	oplus,dtsi_no = <20251>;
};
